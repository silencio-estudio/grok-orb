## firmware/pet/components/board_port/Kconfig
```kconfig
menu "Grok pet board"
    choice PET_BOARD
        prompt "Target board"
        default PET_BOARD_WAVESHARE_143C
        help
            Board port linked into the pet firmware. Each board also needs its
            own flash size and partition table; build with
            firmware/tools/build_pet.py --board, which applies them.

        config PET_BOARD_WAVESHARE_143C
            bool "Waveshare ESP32-S3-Touch-AMOLED-1.43C"
        config PET_BOARD_WAVESHARE_175C
            bool "Waveshare ESP32-S3-Touch-AMOLED-1.75C"
    endchoice

    config PET_BOARD_SHORT_NAME
        string
        default "1.75C" if PET_BOARD_WAVESHARE_175C
        default "1.43C"
endmenu
```

## firmware/pet/components/pet_strings/Kconfig
```kconfig
menu "Grok pet interface"
    choice PET_LANG
        prompt "Interface language"
        default PET_LANG_ES
        help
            Language of the on-screen texts. Spanish needs only the Latin-1
            Montserrat font; Chinese also links the Unifont CJK font
            (about 820 KB more in flash).

        config PET_LANG_ES
            bool "Spanish"
        config PET_LANG_ZH
            bool "Chinese (adds the CJK font)"
    endchoice

    choice PET_THEME
        prompt "Theme"
        default PET_THEME_SMOOTH
        help
            Smooth: the round pink orb with anti-aliased Montserrat text.
            8-bit: a 16-colour PICO-8-style palette, pixel text (Press Start 2P
            titles, Unifont body), square widgets and a dithered orb drawn in
            8 px blocks at 8 frames/s. Both use the same spring-based motion.

        config PET_THEME_SMOOTH
            bool "Smooth"
        config PET_THEME_PIXEL
            bool "8-bit"
    endchoice

    config PET_DISPLAY_NAME
        string "Name shown on screen"
        default "Grok Orb"
        help
            The single title of Settings and of the connection page, followed
            by the battery level on the same line when there is a battery.
            The main orb screen does not show it.
endmenu
```
